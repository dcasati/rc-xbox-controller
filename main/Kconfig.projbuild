## main/Kconfig.projbuild
```kconfig
menu "RC Xbox Controller Config"

    config RC_WIFI_SSID
        string "Wi-Fi SSID"
        default "myssid"
        help
            SSID of the Wi-Fi network to connect to for OTA updates.

    config RC_WIFI_PASSWORD
        string "Wi-Fi Password"
        default "mypassword"
        help
            Password of the Wi-Fi network to connect to for OTA updates.

endmenu
```

## sdkconfig.defaults
```kconfig
#
# ESP32 options
#
CONFIG_COMPILER_OPTIMIZATION_PERF=y
CONFIG_ESPTOOLPY_FLASHSIZE_4MB=y
CONFIG_ESP32_XTAL_FREQ_AUTO=y
CONFIG_XTAL_FREQ_AUTO=y

# Bluetooth related
CONFIG_BT_ENABLED=y
CONFIG_BT_CONTROLLER_ONLY=y
CONFIG_BTDM_CTRL_MODE_BTDM=y
CONFIG_BTDM_CTRL_BR_EDR_MAX_ACL_CONN=5
CONFIG_BTDM_CTRL_BLE_MAX_CONN=5
CONFIG_BTDM_CTRL_BR_EDR_MAX_SYNC_CONN=0
CONFIG_BTDM_CTRL_AUTO_LATENCY=y
CONFIG_BTDM_CTRL_MODEM_SLEEP=n

CONFIG_ESP_COREDUMP_ENABLE_TO_FLASH=y

# Wi-Fi
CONFIG_ESP_WIFI_ENABLED=y
CONFIG_ESP_WIFI_IRAM_OPT=n
CONFIG_ESP_WIFI_RX_IRAM_OPT=n
CONFIG_LWIP_IRAM_OPTIMIZATION=n

# Partition table — custom for OTA
CONFIG_PARTITION_TABLE_CUSTOM=y
CONFIG_PARTITION_TABLE_CUSTOM_FILENAME="partitions.csv"

# FreeRTOS
CONFIG_FREERTOS_USE_TRACE_FACILITY=y
CONFIG_FREERTOS_USE_STATS_FORMATTING_FUNCTIONS=y

# Bluepad32
CONFIG_BLUEPAD32_MAX_DEVICES=1
CONFIG_BLUEPAD32_PLATFORM_CUSTOM=y

# BTstack
CONFIG_BTSTACK_AUDIO=n

# LEDC PWM (for motor control)
# Use high-speed timer for better PWM resolution
```
